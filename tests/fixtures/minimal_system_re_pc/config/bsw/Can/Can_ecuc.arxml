AUTOSAR XML (schema 00046)
package /ActiveEcuC
  module config Can: implementation-config-variant=VARIANT-PRE-COMPILE
    CanGeneral:
      CanDevErrorDetection = false
      CanIndex = 0
      CanMainFunctionModePeriod = 0.01
      CanMultiplexedTransmission = false
      CanTimeoutDuration = 0.001
      CanVersionInfoApi = false
      CanPcRpc: CanRpcHost=127.0.0.1, CanRpcPort=17320, CanRpcSocketPath=, CanRpcAutoReconnect=true, CanRpcReconnectIntervalMs=500
      CanMainFunctionRWPeriod_0 (CanMainFunctionRWPeriods): CanMainFunctionPeriod=0.01
    CanConfigSet
      CanController_0 (CanController):
        CanBusoffProcessing = POLLING
        CanRpcVendor = simulate
        CanRxProcessing = POLLING
        CanTxProcessing = POLLING
        CanWakeupProcessing = POLLING
        CanControllerActivation = true
        CanControllerId = 0
        CanRpcCanFd = false
        CanRpcHandle = 1
        CanWakeupFunctionalityAPI = false
        CanWakeupSupport = false
        CanControllerDefaultBaudrate = CanControllerBaudrateConfig_0
        CanControllerBaudrateConfig_0 (CanControllerBaudrateConfig):
          CanControllerBaudRate = 500
          CanControllerBaudRateConfigID = 0
          CanControllerPropSeg = 2
          CanControllerSeg1 = 13
          CanControllerSeg2 = 2
          CanControllerSyncJumpWidth = 1
      3 x CanHardwareObject, all with CanHandleType=BASIC, CanIdType=STANDARD, CanHwObjectCount=1, CanControllerRef=CanController_0, CanMainFunctionRWPeriodRef=CanMainFunctionRWPeriod_0:
        CanHth_0: CanObjectType=TRANSMIT, CanObjectId=0
        CanHrh_0: CanObjectType=RECEIVE, CanObjectId=2
        CanHth_1: CanObjectType=TRANSMIT, CanObjectId=1
