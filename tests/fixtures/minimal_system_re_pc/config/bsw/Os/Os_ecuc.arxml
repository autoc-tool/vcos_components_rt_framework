AUTOSAR XML (schema 00046)
package /ActiveEcuC
  module config Os: implementation-config-variant=VARIANT-PRE-COMPILE, module-description=Os_Impl
    OSDEFAULTAPPMODE (OsAppMode)
    OSAUTOSTARTMODE (OsAppMode)
    4 x OsApplication, all with OsIsPrivileged=true, OsAppMemoryProtectionIdentifier=, OsAppIsrRef=(unset):
      SystemApplication_Core0: OsAppCounterRef=OsCounter_0, OsAppEcucPartitionRef=EcucPartition_0, OsApplicationCoreRef=EcucCoreDefinition0, OsAppScheduleTableRef=SchTbl_5ms, OsAppTaskRef=core0_shell, OsAppScheduleTableRef=SchTbl_10ms, OsAppTaskRef=OsTask_Init, OsAppTaskRef=OsTask_5ms, OsAppTaskRef=OsTask_10ms
      SystemApplication_Core{1..3}: OsAppCounterRef=(unset), OsAppEcucPartitionRef=EcucPartition_{1..3}, OsApplicationCoreRef=EcucCoreDefinition{1..3}, OsAppScheduleTableRef=(unset), OsAppTaskRef=core{1..3}_shell
    4 x OsTask, all with OsTaskUsesFpu=true, OsTaskActivation=1, OsTaskStackSize=4096, OsTaskType=EXTENDED, OsTaskSchedule=FULL, OsTaskEventRef=(unset), OsTaskResourceRef=(unset):
      core0_shell: OsTaskPriority=10, OsTaskAccessingApplication=SystemApplication_Core0
        OsTaskAutostart: OsTaskAppModeRef=OSAUTOSTARTMODE
      core1_shell: OsTaskPriority=10, OsTaskAccessingApplication=SystemApplication_Core1
        OsTaskAutostart: OsTaskAppModeRef=OSAUTOSTARTMODE
      core2_shell: OsTaskPriority=5, OsTaskAccessingApplication=SystemApplication_Core2
        OsTaskAutostart: OsTaskAppModeRef=OSAUTOSTARTMODE
      core3_shell: OsTaskPriority=5, OsTaskAccessingApplication=SystemApplication_Core3
        OsTaskAutostart: OsTaskAppModeRef=OSAUTOSTARTMODE
    4 x OsCore:
      OsCore{0..3}: OsCoreBswApplicationRef=SystemApplication_Core{0..3}, OsCoreEcucIdRef=EcucCoreDefinition{0..3}
    OsPublishedInformation: OsKernelVersion=V1.0.0, OsPlatformName=PC_Common
      OsDerivativeInformation: OsStackAlignment=8
        4 x OsPhysicalCore:
          OsPhysicalCore{0..3}: OsPhysicalCoreId={0..3}
    3 x OsTask, all with OsTaskActivation=1, OsTaskUsesFpu=false, OsTaskSchedule=FULL, OsTaskAccessingApplication=SystemApplication_Core0:
      OsTask_Init: OsTaskPriority=30, OsTaskStackSize=8192, OsTaskType=BASIC
        OsTaskAutostart: OsTaskAppModeRef=OSAUTOSTARTMODE
      OsTask_5ms: OsTaskPriority=20, OsTaskStackSize=4096, OsTaskType=EXTENDED, OsTaskEventRef=Rte_Ev_Cyclic2_OsTask_5ms_0_5ms
      OsTask_10ms: OsTaskPriority=15, OsTaskStackSize=8192, OsTaskType=EXTENDED, OsTaskEventRef=Rte_Ev_Cyclic_OsTask_10ms_0_10ms, OsTaskEventRef=Rte_Ev_Cyclic2_OsTask_10ms_0_10ms
    OsCounter_0 (OsCounter):
      OsCounterMaxAllowedValue = 1073741823
      OsCounterMinCycle = 1
      OsCounterTicksPerBase = 1
      OsSecondsPerTick = 0.001
      OsCounterType = SOFTWARE
      OsCounterAccessingApplication = SystemApplication_Core0
    4 x OsEvent:
      Rte_Ev_Cyclic2_OsTask_5ms_0_5ms
      Rte_Ev_Cyclic_OsTask_10ms_0_10ms
      Rte_Ev_Cyclic2_OsTask_10ms_0_10ms
      Rte_Ev_MinimalSystem_SysCycleTE
    SchTbl_5ms (OsScheduleTable): OsScheduleTableDuration=5, OsScheduleTableRepeating=true, OsScheduleTableCounterRef=OsCounter_0
      OsScheduleTableExpiryPoint_0 (OsScheduleTableExpiryPoint): OsScheduleTblExpPointOffset=0
        OsScheduleTableEventSetting_0 (OsScheduleTableEventSetting): OsScheduleTableSetEventRef=Rte_Ev_Cyclic2_OsTask_5ms_0_5ms, OsScheduleTableSetEventTaskRef=OsTask_5ms
      OsScheduleTableAutostart: OsScheduleTableStartValue=0, OsScheduleTableAutostartType=ABSOLUTE, OsScheduleTableAppModeRef=OSAUTOSTARTMODE
    SchTbl_10ms (OsScheduleTable): OsScheduleTableDuration=10, OsScheduleTableRepeating=true, OsScheduleTableCounterRef=OsCounter_0
      OsScheduleTableExpiryPoint_0 (OsScheduleTableExpiryPoint): OsScheduleTblExpPointOffset=0
        OsScheduleTableEventSetting_0 (OsScheduleTableEventSetting): OsScheduleTableSetEventRef=Rte_Ev_Cyclic_OsTask_10ms_0_10ms, OsScheduleTableSetEventTaskRef=OsTask_10ms
        OsScheduleTableEventSetting_1 (OsScheduleTableEventSetting): OsScheduleTableSetEventRef=Rte_Ev_Cyclic2_OsTask_10ms_0_10ms, OsScheduleTableSetEventTaskRef=OsTask_10ms
      OsScheduleTableAutostart: OsScheduleTableStartValue=0, OsScheduleTableAutostartType=ABSOLUTE, OsScheduleTableAppModeRef=OSAUTOSTARTMODE
