AUTOSAR XML (schema 00046)
package /ActiveEcuC
  module config Crc: implementation-config-variant=VARIANT-PRE-COMPILE, module-description=Crc_Impl
    CrcGeneral:
      Crc16ARCMode = CRC_16_ARC_TABLE
      Crc16Mode = CRC_16_TABLE
      Crc32Mode = CRC_32_TABLE
      Crc32P4Mode = CRC_32P4_TABLE
      Crc64Mode = CRC_64_TABLE
      Crc8H2FMode = CRC_8H2F_TABLE
      Crc8Mode = CRC_8_TABLE
