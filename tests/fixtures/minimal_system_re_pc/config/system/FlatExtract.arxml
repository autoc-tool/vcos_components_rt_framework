AUTOSAR XML (schema 4-2-1)
package /COM/VCOS2/CFG/WORKFLOW/SYSDESC/SYNC
  end to end protection set E2EPROTECTIONSET
  port interface mapping set PORTINTERFACEMAPPINGSET
  system SYSTEM: category=ECU_EXTRACT
    system mapping MAPPINGS
      data-mappings:
        data-element=MinimalSystem.COMPOSITIONTYPE.CmdControl.LedCmd, system-signal=LedCmd
        data-element=MinimalSystem.COMPOSITIONTYPE.CmdControl.TargetMode, system-signal=TargetMode
        data-element=MinimalSystem.COMPOSITIONTYPE.CmdControl.Cmd_AliveCnt, system-signal=Cmd_AliveCnt
        data-element=MinimalSystem.COMPOSITIONTYPE.CmdControl.PwmDuty, system-signal=PwmDuty
        data-element=MinimalSystem.COMPOSITIONTYPE.CmdControl.Cmd_Crc8, system-signal=Cmd_Crc8
        data-element=MinimalSystem.COMPOSITIONTYPE.EcuStatus.ECU_State, system-signal=ECU_State
        data-element=MinimalSystem.COMPOSITIONTYPE.EcuStatus.ECU_AliveCnt, system-signal=ECU_AliveCnt
        data-element=MinimalSystem.COMPOSITIONTYPE.EcuStatus.Temperature, system-signal=Temperature
        data-element=MinimalSystem.COMPOSITIONTYPE.EcuStatus.SupplyVoltage, system-signal=SupplyVoltage
        data-element=MinimalSystem.COMPOSITIONTYPE.EcuStatus.FaultFlags, system-signal=FaultFlags
        data-element=MinimalSystem.COMPOSITIONTYPE.FaultEvent.FaultCode, system-signal=FaultCode
        data-element=MinimalSystem.COMPOSITIONTYPE.FaultEvent.FaultActive, system-signal=FaultActive
      sw-mappings:
        swc to ecu mapping SwcToEcuMapping: component=[COMPOSITIONTYPE.MinimalSystem, COMPOSITIONTYPE.IoHwAb], ecu-instance=DUT
    root-software-compositions:
      root sw composition prototype COMPOSITIONTYPE: flat-map=FLATMAP, software-composition=COMPOSITIONTYPE
package /ComponentTypes
  swc implementation MinimalSystem_Impl: behavior=MinimalSystem_IB
  swc implementation IoHwAb_Impl: behavior=IoHwAb_IB
package /ECUCompositionTypes
  composition sw component type EcuSwCompositionStub
