AUTOSAR XML (schema 00046)
package /InitialEcuC
  module config Dcm: implementation-config-variant=VARIANT-PRE-COMPILE
    DcmConfigSet
    DcmGeneral:
      DcmDDDIDStorage = false
      DcmDevErrorDetect = false
      DcmRespondAllRequest = false
      DcmVersionInfoApi = false
      DcmTaskTime = 0.01
      DcmHeaderFileInclusion = <empty>
      DcmVinRef = <empty>
  module config Dem: implementation-config-variant=VARIANT-PRE-COMPILE
    DemGeneral:
      DemAgingRequiresNotFailedCycle = false
      DemAgingRequiresTestedCycle = false
      DemDebounceCounterBasedSupport = false
      DemDebounceTimeBasedSupport = false
      DemDevErrorDetect = false
      DemGeneralInterfaceSupport = false
      DemPTOSupport = false
      DemResetConfirmedBitOnOverflow = true
      DemStatusBitStorageTestFailed = false
      DemTriggerFiMReports = false
      DemTriggerMonitorInitBeforeClearOk = false
      DemVersionInfoApi = false
      DemTaskTime = 0.01
      DemBswErrorBufferSize = 0
      DemMaxNumberEventEntryEventBuffer = 1
      DemMaxNumberPrestoredFF = 0
      DemAvailabilitySupport = DEM_EVENT_AVAILABILITY
      DemClearDTCBehavior = DEM_CLRRESP_NONVOLATILE_FINISH
      DemClearDTCLimitation = DEM_ALL_SUPPORTED_DTCS
      DemDataElementDefaultEndianness = BIG_ENDIAN
      DemEventCombinationSupport = DEM_EVCOMB_DISABLED
      DemOBDSupport = DEM_OBD_NO_OBD_SUPPORT
      DemStatusBitHandlingTestFailedSinceLastClear = DEM_STATUS_BIT_NORMAL
      DemSuppressionSupport = DEM_DTC_SUPPRESSION
      DemGeneralCallbackMonitorStatusChangedFnc = 
      DemOBDEventMemorySetRef = 
    DemConfigSet
  module config NvM
    NvMCommonVendorParams: NvMCfgCbkIncludeList=(unset)
    NvMBlockDescriptor:
      NvMBlockUseAutoValidation = false
      NvMBlockUseCrc = (unset)
      NvMBlockUseCRCCompMechanism = false
      NvMBlockUseSetRamBlockStatus = (unset)
      NvMBlockUseSyncMechanism = false
      NvMBlockWriteProt = (unset)
      NvMBswMBlockStatusInformation = false
      NvMCalcRamBlockCrc = (unset)
      NvMResistantToChangedSw = (unset)
      NvMSelectBlockForFirstInitAll = false
      NvMSelectBlockForReadAll = (unset)
      NvMSelectBlockForWriteAll = (unset)
      NvMStaticBlockIDCheck = false
      NvMWriteBlockOnce = (unset)
      NvMWriteVerification = false
      NvMBlockJobPriority = (unset)
      NvMMaxNumOfReadRetries = 0
      NvMMaxNumOfWriteRetries = (unset)
      NvMNvBlockBaseNumber = (unset)
      NvMNvBlockLength = (unset)
      NvMNvBlockNum = (unset)
      NvMNvramBlockIdentifier = (unset)
      NvMNvramDeviceId = (unset)
      NvMRomBlockNum = 0
      NvMWriteVerificationDataSize = 1
      NvMBlockCrcType = (unset)
      NvMBlockManagementType = (unset)
      NvMInitBlockCallback = (unset)
      NvMReadRamBlockFromNvCallback = (unset)
      NvMSingleBlockCallback = (unset)
      NvMWriteRamBlockToNvCallback = (unset)
      NvMBlockHeaderInclude = NULL
      NvMRamBlockDataAddress = (unset)
      NvMRomBlockDataAddress = (unset)
      NvMTargetBlockReference
    NvMCommon:
      NvMBswMMultiBlockJobStatusInformation = true
      NvMDevErrorDetect = false
      NvMDrvModeSwitch = (unset)
      NvMDynamicConfiguration = (unset)
      NvMJobPrioritization = (unset)
      NvMPollingMode = (unset)
      NvMSetRamBlockStatusApi = (unset)
      NvMVersionInfoApi = false
      NvMMainFunctionPeriod = (unset)
      NvMCompiledConfigId = (unset)
      NvMCrcNumOfBytes = 65535
      NvMDatasetSelectionBits = (unset)
      NvMRepeatMirrorOperations = 0
      NvMSizeImmediateJobQueue = (unset)
      NvMSizeStandardJobQueue = (unset)
      NvMApiConfigClass = (unset)
      NvMMultiBlockCallback = (unset)
  ecuc value collection InitialEcuC: ecuc-values=[Dcm, Dem]
